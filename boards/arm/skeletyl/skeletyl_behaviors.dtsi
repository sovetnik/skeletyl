// Behavior and macro definitions extracted from skeletyl.keymap

// custom implementation of modified callum-mods,
// which can be released on second keypress
// and also work with swapper and/or tabber

#define PARAM_1 0
#define PARAM_2 0

#define MACRO(NAME, COMPATIBLE, BINDING_CELLS, BINDINGS) \
    NAME: NAME { \
        compatible = COMPATIBLE; \
        #binding-cells = <BINDING_CELLS>; \
        wait-ms = <0>; \
        tap-ms = <0>; \
        bindings = \
            <BINDINGS>; \
    };

#define MACRO_NO_PARAM(NAME, BINDINGS)  MACRO(NAME, "zmk,behavior-macro"          , 0, BINDINGS)
#define MACRO_ONE_PARAM(NAME, BINDINGS) MACRO(NAME, "zmk,behavior-macro-one-param", 1, BINDINGS)
#define MACRO_TWO_PARAM(NAME, BINDINGS) MACRO(NAME, "zmk,behavior-macro-two-param", 2, BINDINGS)

#define MAX_TIMER __UINT32_MAX__ // around 50 days

#define STICKY_FOREVER(NAME, BIND) \
    NAME: NAME { \
        compatible = "zmk,behavior-sticky-key"; \
        #binding-cells = <1>; \
        bindings = <BIND>; \
        release-after-ms = <MAX_TIMER>; \
        ignore-modifiers; \
    };

#define MODMORPH(NAME, NORMAL, MORPHED, MODS, KEEP_MODS) \
    NAME: NAME { \
        compatible = "zmk,behavior-mod-morph"; \
        #binding-cells = <0>; \
        bindings = <NORMAL>, <MORPHED>; \
        mods = <(MODS)>; \
        keep-mods = <(KEEP_MODS)>; \
    };

&sk {
        release-after-ms = <60000>;
};

/ {
    behaviors {
        MACRO_ONE_PARAM(
            m_release_key_twice,
            &macro_release
                &macro_param_1to1 &kp PARAM_1
                &macro_param_1to1 &kp PARAM_1
        )


        MACRO_ONE_PARAM(
            m_press_key_twice,
            &macro_press
                &macro_param_1to1 &kp PARAM_1
                &macro_param_1to1 &kp PARAM_1
            &macro_pause_for_release
            &macro_tap
                &m_release_key_twice PARAM_1
        )

        STICKY_FOREVER(sticky_forever, &m_press_key_twice)

        MODMORPH(
            cm_gui,
            &sticky_forever LGUI,
            &m_release_key_twice LGUI,
            MOD_LGUI,
            MOD_LGUI
        )

        MODMORPH(
            cm_alt,
            &sticky_forever LALT,
            &m_release_key_twice LALT,
            MOD_LALT,
            MOD_LALT
        )

        MODMORPH(
            cm_ctrl,
            &sticky_forever LCTRL,
            &m_release_key_twice LCTRL,
            MOD_LCTL,
            MOD_LCTL
        )

        MODMORPH(
            cm_sft,
            &sticky_forever LSHIFT,
            &m_release_key_twice LSHIFT,
            MOD_LSFT,
            MOD_LSFT
        )

        MACRO_TWO_PARAM(
            m_hold_mod_press_key,
            &macro_press
                &macro_param_1to1 &kp PARAM_1
            &macro_tap
                &macro_param_2to1 &kp PARAM_2
        )

        MODMORPH(
            tabber,
            &m_hold_mod_press_key LCTRL TAB,
            &kp TAB,
            MOD_LCTL,
            MOD_LCTL
        )

        MODMORPH(
            swapper_win,
            &m_hold_mod_press_key LALT TAB,
            &kp TAB,
            MOD_LALT,
            MOD_LALT
        )

        MODMORPH(
            swapper_mac,
            &m_hold_mod_press_key LGUI TAB,
            &kp TAB,
            MOD_LGUI,
            MOD_LGUI
        )

        MACRO_NO_PARAM(
            m_elpipe,
            &macro_tap
                &kp LS(BSLH)
                &kp RA(P)
                &kp SPACE
        )

        MACRO_NO_PARAM(
            m_insl,
            &macro_tap
                &kp I
                &kp N
                &kp S
                &kp L
        )

        MACRO_NO_PARAM(
            m_leq,
            &macro_tap
                &kp SPACE
                &kp RA(O)
                &kp EQUAL
                &kp SPACE
        )

        MACRO_NO_PARAM(
            m_req,
            &macro_tap
                &kp SPACE
                &kp EQUAL
                &kp RA(P)
                &kp SPACE
        )

        MACRO_NO_PARAM(
            m_elmap,
            &macro_tap
                &kp N5
                &kp LS(RA(DOT))
                &kp SPACE
        )

        MACRO_NO_PARAM(
            m_ldsh,
            &macro_tap
                &kp SPACE
                &kp RA(O)
                &kp MINUS
                &kp SPACE
        )

        MACRO_NO_PARAM(
            m_rdsh,
            &macro_tap
                &kp SPACE
                &kp MINUS
                &kp RA(P)
                &kp SPACE
        )

        MACRO_ONE_PARAM(
            la,
            &macro_tap
                &kp 0 // do nothing, fire all sticky keys
            &macro_press
                &macro_param_1to1 &mo PARAM_1
            &macro_pause_for_release
            &macro_release
                &macro_param_1to1 &mo PARAM_1
                &kp LSHFT
                &kp LCTRL
                &kp LALT
                &kp LGUI
        )
    };
};
