## boards/arm/skeletyl/Kconfig.board
```kconfig
# Copyright (c) 2020-2021 Thys de Wet (vattern)
# SPDX-License-Identifier: MIT

config BOARD_SKELETYL
	select SOC_NRF52840_QIAA

config BOARD_SKELETYL_LEFT
	select SOC_NRF52840_QIAA

config BOARD_SKELETYL_RIGHT
	select SOC_NRF52840_QIAA
```

## boards/arm/skeletyl/board.yml
```yaml
boards:
  - name: skeletyl_left
    vendor: bastardkb
    socs:
      - name: nrf52840
  - name: skeletyl_right
    vendor: bastardkb
    socs:
      - name: nrf52840
```

## boards/shields/skeletyl_dongle/Kconfig.defconfig
```kconfig
if SHIELD_SKELETYL_DONGLE

config ZMK_KEYBOARD_NAME
	default "Skeletyl"

config ZMK_SPLIT_ROLE_CENTRAL
	default y

config ZMK_SPLIT
	default y

endif
```
