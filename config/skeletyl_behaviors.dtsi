// Behavior and macro definitions extracted from skeletyl.keymap
//
// GUI/ALT/CTRL/SHIFT live as home-row mods (hml/hmr below) directly on
// DEFAULT, ported from charybdis/config/charybdis_behaviors.dtsi. The prior
// cm_gui/cm_alt/cm_ctrl/cm_sft sticky-mod macro chain (sticky_forever +
// m_press_key_twice/m_release_key_twice) is gone - on charybdis's dongle
// topology this construction reproducibly crashed the whole BLE/USB link
// (see charybdis/changelog.md); it never crashed here since skeletyl has no
// dongle, but there's no reason to keep two different modifier systems
// across the two personal keyboards, and home-row mods are structurally
// simpler (no sticky-pending state, no conflict with swapper_mac/tabber's
// cleanup in `la`).

#define PARAM_1 0
#define PARAM_2 0

#define MACRO(NAME, COMPATIBLE, BINDING_CELLS, BINDINGS) \
    NAME: NAME { \
        compatible = COMPATIBLE; \
        #binding-cells = <BINDING_CELLS>; \
        wait-ms = <0>; \
        tap-ms = <0>; \
        bindings = \
            <BINDINGS>; \
    };

#define MACRO_NO_PARAM(NAME, BINDINGS)  MACRO(NAME, "zmk,behavior-macro"          , 0, BINDINGS)
#define MACRO_ONE_PARAM(NAME, BINDINGS) MACRO(NAME, "zmk,behavior-macro-one-param", 1, BINDINGS)
#define MACRO_TWO_PARAM(NAME, BINDINGS) MACRO(NAME, "zmk,behavior-macro-two-param", 2, BINDINGS)

#define MODMORPH(NAME, NORMAL, MORPHED, MODS, KEEP_MODS) \
    NAME: NAME { \
        compatible = "zmk,behavior-mod-morph"; \
        #binding-cells = <0>; \
        bindings = <NORMAL>, <MORPHED>; \
        mods = <(MODS)>; \
        keep-mods = <(KEEP_MODS)>; \
    };

// timeless home-row mods, per ZMK's own docs (keymaps/behaviors/hold-tap.mdx):
// balanced + require-prior-idle-ms resolves to tap immediately when typing
// at speed; hold-trigger-key-positions + hold-trigger-on-release means hold
// only resolves on a cross-hand combo, not mid-word same-hand rolls.
// KEYS_R/KEYS_L: alpha positions 0-29 split by hand. THUMBS: 30-35, both
// hands' three thumb keys included in both (skeletyl's cluster is 3+3,
// unlike charybdis's 3+2), since thumb+mod combos (Cmd+Space etc.) are common.
#define KEYS_R 5 6 7 8 9 15 16 17 18 19 25 26 27 28 29
#define KEYS_L 0 1 2 3 4 10 11 12 13 14 20 21 22 23 24
#define THUMBS 30 31 32 33 34 35

/ {
    behaviors {
        hml: home_row_mod_left {
            compatible = "zmk,behavior-hold-tap";
            #binding-cells = <2>;
            flavor = "balanced";
            require-prior-idle-ms = <150>;
            tapping-term-ms = <280>;
            quick-tap-ms = <175>;
            bindings = <&kp>, <&kp>;
            hold-trigger-key-positions = <KEYS_R THUMBS>;
            hold-trigger-on-release;
        };

        hmr: home_row_mod_right {
            compatible = "zmk,behavior-hold-tap";
            #binding-cells = <2>;
            flavor = "balanced";
            require-prior-idle-ms = <150>;
            tapping-term-ms = <280>;
            quick-tap-ms = <175>;
            bindings = <&kp>, <&kp>;
            hold-trigger-key-positions = <KEYS_L THUMBS>;
            hold-trigger-on-release;
        };

        MACRO_TWO_PARAM(
            m_hold_mod_press_key,
            &macro_press
                &macro_param_1to1 &kp PARAM_1
            &macro_tap
                &macro_param_2to1 &kp PARAM_2
        )

        MODMORPH(
            tabber,
            &m_hold_mod_press_key LCTRL TAB,
            &kp TAB,
            MOD_LCTL,
            MOD_LCTL
        )

        MODMORPH(
            swapper_win,
            &m_hold_mod_press_key LALT TAB,
            &kp TAB,
            MOD_LALT,
            MOD_LALT
        )

        MODMORPH(
            swapper_mac,
            &m_hold_mod_press_key LGUI TAB,
            &kp TAB,
            MOD_LGUI,
            MOD_LGUI
        )

        MACRO_NO_PARAM(
            m_elpipe,
            &macro_tap
                &kp LS(BSLH)
                &kp RA(P)
                &kp SPACE
        )

        MACRO_NO_PARAM(
            m_insl,
            &macro_tap
                &kp I
                &kp N
                &kp S
                &kp L
        )

        MACRO_NO_PARAM(
            m_leq,
            &macro_tap
                &kp SPACE
                &kp RA(O)
                &kp EQUAL
                &kp SPACE
        )

        MACRO_NO_PARAM(
            m_req,
            &macro_tap
                &kp SPACE
                &kp EQUAL
                &kp RA(P)
                &kp SPACE
        )

        MACRO_NO_PARAM(
            m_elmap,
            &macro_tap
                &kp N5
                &kp LS(RA(DOT))
                &kp SPACE
        )

        MACRO_NO_PARAM(
            m_ldsh,
            &macro_tap
                &kp SPACE
                &kp RA(O)
                &kp MINUS
                &kp SPACE
        )

        MACRO_NO_PARAM(
            m_rdsh,
            &macro_tap
                &kp SPACE
                &kp MINUS
                &kp RA(P)
                &kp SPACE
        )

        MACRO_ONE_PARAM(
            la,
            &macro_tap
                &kp 0 // do nothing, fire all sticky keys
            &macro_press
                &macro_param_1to1 &mo PARAM_1
            &macro_pause_for_release
            &macro_release
                &macro_param_1to1 &mo PARAM_1
                &kp LSHFT
                &kp LCTRL
                &kp LALT
                &kp LGUI
        )
    };
};
